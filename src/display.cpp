#include "display.h"
#include "driver/i2c_master.h"
#include "freertos/FreeRTOS.h"
#include "freertos/task.h"
#include <string.h>

#define I2C_PORT      I2C_NUM_0
#define OLED_ADDR     0x3C
#define SDA_PIN       GPIO_NUM_18
#define SCL_PIN       GPIO_NUM_19

static i2c_master_bus_handle_t  bus_handle;
static i2c_master_dev_handle_t  oled_handle;

static void i2c_master_init(void)
{
    i2c_master_bus_config_t bus_cfg = {};
    bus_cfg.i2c_port = I2C_PORT;
    bus_cfg.sda_io_num = SDA_PIN;
    bus_cfg.scl_io_num = SCL_PIN;
    bus_cfg.clk_source = I2C_CLK_SRC_DEFAULT;
    bus_cfg.glitch_ignore_cnt = 7;
    bus_cfg.flags.enable_internal_pullup = true;
    i2c_new_master_bus(&bus_cfg, &bus_handle);

    i2c_device_config_t dev_cfg = {};
    dev_cfg.dev_addr_length = I2C_ADDR_BIT_LEN_7;
    dev_cfg.device_address = OLED_ADDR;
    dev_cfg.scl_speed_hz = 400000;
    i2c_master_bus_add_device(bus_handle, &dev_cfg, &oled_handle);
}

static void ssd1306_cmd(uint8_t cmd)
{
    uint8_t buf[2] = {0x00, cmd};
    i2c_master_transmit(oled_handle, buf, 2, pdMS_TO_TICKS(100));
    vTaskDelay(1);   // break burst timing for Wokwi's I2C simulator
}

static void ssd1306_data(const uint8_t *data, size_t len)
{
    uint8_t buf[17];
    buf[0] = 0x40;
    memcpy(&buf[1], data, len);
    i2c_master_transmit(oled_handle, buf, len + 1, pdMS_TO_TICKS(100));
    vTaskDelay(1);   // break burst timing for Wokwi's I2C simulator
}

static const uint8_t *glyph(char c)
{
    static const uint8_t SP[5]  = {0x00,0x00,0x00,0x00,0x00};
    static const uint8_t DOT[5] = {0x00,0x60,0x60,0x00,0x00};
    static const uint8_t DSH[5] = {0x08,0x08,0x08,0x08,0x08};
    static const uint8_t PCT[5] = {0x23,0x13,0x08,0x64,0x62};
    static const uint8_t COL[5] = {0x00,0x36,0x36,0x00,0x00};
    static const uint8_t D[10][5] = {
        {0x3E,0x51,0x49,0x45,0x3E}, {0x00,0x42,0x7F,0x40,0x00},
        {0x42,0x61,0x51,0x49,0x46}, {0x21,0x41,0x45,0x4B,0x31},
        {0x18,0x14,0x12,0x7F,0x10}, {0x27,0x45,0x45,0x45,0x39},
        {0x3C,0x4A,0x49,0x49,0x30}, {0x01,0x71,0x09,0x05,0x03},
        {0x36,0x49,0x49,0x49,0x36}, {0x06,0x49,0x49,0x29,0x1E},
    };
    static const uint8_t A[26][5] = {
        {0x7E,0x11,0x11,0x11,0x7E}, {0x7F,0x49,0x49,0x49,0x36},
        {0x3E,0x41,0x41,0x41,0x22}, {0x7F,0x41,0x41,0x22,0x1C},
        {0x7F,0x49,0x49,0x49,0x41}, {0x7F,0x09,0x09,0x09,0x01},
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        {0x07,0x08,0x70,0x08,0x07}, {0x61,0x51,0x49,0x45,0x43},
    };
    if (c == ' ') return SP;
    if (c == '.') return DOT;
    if (c == '-') return DSH;
    if (c == '%') return PCT;
    if (c == ':') return COL;
    if (c >= '0' && c <= '9') return D[c - '0'];
    if (c >= 'A' && c <= 'Z') return A[c - 'A'];
    return SP;
}

void display_init(void)
{
    i2c_master_init();
    const uint8_t init_seq[] = {
        0xAE, 0x20, 0x02, 0xB0, 0xC8, 0x00, 0x10, 0x40,
        0x81, 0x7F, 0xA1, 0xA6, 0xA8, 0x3F, 0xA4,
        0xD3, 0x00, 0xD5, 0x80, 0xD9, 0xF1, 0xDA, 0x12,
        0xDB, 0x40, 0x8D, 0x14, 0xAF
    };
    for (size_t i = 0; i < sizeof(init_seq); i++) {
        ssd1306_cmd(init_seq[i]);
    }
}

static void set_cursor(uint8_t page, uint8_t col)
{
    ssd1306_cmd(0xB0 + page);
    ssd1306_cmd(0x00 + (col & 0x0F));
    ssd1306_cmd(0x10 + ((col >> 4) & 0x0F));
}

void display_clear(void)
{
    const uint8_t blank[16] = {0};
    for (uint8_t page = 0; page < 8; page++) {
        set_cursor(page, 0);
        for (int i = 0; i < 8; i++) {
            ssd1306_data(blank, 16);
        }
    }
}

void display_draw_string(uint8_t page, uint8_t col, const char *str)
{
    set_cursor(page, col);
    while (*str) {
        ssd1306_data(glyph(*str), 5);
        const uint8_t gap[1] = {0x00};
        ssd1306_data(gap, 1);
        str++;
    }
}